## prj.conf
```kconfig
CONFIG_GPIO=y
CONFIG_LOG=y
CONFIG_USE_SEGGER_RTT=y
CONFIG_RTT_CONSOLE=y

#Disable External Flash
CONFIG_NORDIC_QSPI_NOR=n
#CONFIG_BUILD_WITH_TFM=n

CONFIG_SOC_ENABLE_LFXO=n
CONFIG_CLOCK_CONTROL_NRF_K32SRC_SYNTH=y

CONFIG_DK_LIBRARY=y
CONFIG_BOARD_ENABLE_CPUNET=y

CONFIG_BT=y
CONFIG_BT_HCI=y
CONFIG_NCS_INCLUDE_RPMSG_CHILD_IMAGE=n # Make sure NCS build system won't build network core for us

# STEP 2 - Set the Bluetooth LE device name
CONFIG_BT_DEVICE_NAME="Grisen"

# Increase stack size for the main thread and System Workqueue
CONFIG_SYSTEM_WORKQUEUE_STACK_SIZE=2048
CONFIG_MAIN_STACK_SIZE=2048
```

## boards/clock.overlay
```dts
/ {   
    hfxo { 
        load-capacitors = "internal"; 
    load-capacitance-femtofarad = <16000>; 
    };
};
```

## boards/dk_mfs.overlay
```dts
/ {
    leds {
        compatible = "gpio-leds";
        led0: led_0 {
            gpios = <&gpio0 28 GPIO_ACTIVE_LOW>;  // Check if this matches your board design
            label = "LED0";
        };
    };
};
```

## boards/mfs_dk.overlay
```dts
/*
 * Copyright (c) 2024 Nordic Semiconductor ASA
 *
 * SPDX-License-Identifier: LicenseRef-Nordic-5-Clause
 */

 / {
    leds {
        compatible = "gpio-leds";
        led1: led_1 {
            gpios = <&gpio0 26 GPIO_ACTIVE_LOW>;  // Check if this matches your board design
            label = "LED1";
        };
    };
};
```

## src/main.c
```c
/*
 * Copyright (c) 2023 Nordic Semiconductor ASA
 *
 * SPDX-License-Identifier: LicenseRef-Nordic-5-Clause
 */

 #include <zephyr/kernel.h>
 #include <zephyr/logging/log.h>
 /* STEP 3 - Include the header file of the Bluetooth LE stack */
 #include <zephyr/bluetooth/bluetooth.h>
 #include <zephyr/bluetooth/gap.h>
 
 #include <dk_buttons_and_leds.h>
 
 LOG_MODULE_REGISTER(Lesson2_Exercise1, LOG_LEVEL_INF);
 
 #define DEVICE_NAME CONFIG_BT_DEVICE_NAME
 #define DEVICE_NAME_LEN (sizeof(DEVICE_NAME) - 1)
 
 #define RUN_STATUS_LED DK_LED1
 #define RUN_LED_BLINK_INTERVAL 1000
 
 /* STEP 4.1.1 - Declare the advertising packet */
 static const struct bt_data ad[] = {
     /* STEP 4.1.2 - Set the advertising flags */
     BT_DATA_BYTES(BT_DATA_FLAGS, BT_LE_AD_NO_BREDR),
     /* STEP 4.1.3 - Set the advertising packet data  */
     BT_DATA(BT_DATA_NAME_COMPLETE, DEVICE_NAME, DEVICE_NAME_LEN),
 
 };
 
 /* STEP 4.2.2 - Declare the URL data to include in the scan response */
 static unsigned char url_data[] = { 0x17, '/', '/', 'a', 'c', 'a', 'd', 'e', 'm',
                     'y',  '.', 'n', 'o', 'r', 'd', 'i', 'c', 's',
                     'e',  'm', 'i', '.', 'c', 'o', 'm' };
 
 /* STEP 4.2.1 - Declare the scan response packet */
 static const struct bt_data sd[] = {
     /* 4.2.3 Include the URL data in the scan response packet */
     BT_DATA(BT_DATA_URI, url_data, sizeof(url_data)),
 };
 
 int main(void)
 {
     int blink_status = 0;
     int err;
 
     LOG_INF("Starting Lesson 2 - Exercise 1 \n");
 
     err = dk_leds_init();
     if (err) {
         LOG_ERR("LEDs init failed (err %d)\n", err);
         return -1;
     }
     /* STEP 5 - Enable the Bluetooth LE stack */
     err = bt_enable(NULL);
     if (err) {
         LOG_ERR("Bluetooth init failed (err %d)\n", err);
         return -1;
     }
 
     LOG_INF("Bluetooth initialized\n");
 
     /* STEP 6 - Start advertising */
     err = bt_le_adv_start(BT_LE_ADV_NCONN, ad, ARRAY_SIZE(ad), sd, ARRAY_SIZE(sd));
     if (err) {
         LOG_ERR("Advertising failed to start (err %d)\n", err);
         return -1;
     }
 
     LOG_INF("Advertising successfully started\n");
 
     for (;;) {
         dk_set_led(RUN_STATUS_LED, (++blink_status) % 2);
         k_sleep(K_MSEC(RUN_LED_BLINK_INTERVAL));
     }
 }
```
