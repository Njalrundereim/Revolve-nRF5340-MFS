## Firmware_MFS/MFS_Clock/ipc_radio/Kconfig/boards/Kconfig.sysbuild
```kconfig
# Load Sysbuild board Kconfig descriptions.
osource "C:/nRF5340_MFS/boards/MFS/Kconfig.sysbuild"
```

## Firmware_MFS/build_Cap/Firmware_MFS/Kconfig/boards/Kconfig.defconfig
```kconfig
# Load Zephyr board defconfig descriptions.
osource "C:/nRF5340_MFS/boards/MFS/Kconfig.defconfig"
```

## Firmware_MFS/build_Cap/ipc_radio/Kconfig/Kconfig.shield
```kconfig
osource "C:/nRF5340_MFS/boards/shields/*/Kconfig.shield"
osource "C:/nRF5340_MFS/Firmware_MFS/boards/shields/*/Kconfig.shield"
osource "C:/ncs/v2.9.0/nrf/boards/shields/*/Kconfig.shield"
```

## Firmware_MFS/build_MFS/ipc_radio/Kconfig/Kconfig.shield.defconfig
```kconfig
osource "C:/nRF5340_MFS/boards/shields/*/Kconfig.defconfig"
osource "C:/nRF5340_MFS/Firmware_MFS/boards/shields/*/Kconfig.defconfig"
osource "C:/ncs/v2.9.0/nrf/boards/shields/*/Kconfig.defconfig"
```

## boards/MFS/board.yml
```yaml
board:
  name: mfs
  full_name: MFS
  vendor: nordic
  socs:
  - name: 'nrf5340'
    variants:
    - name: 'ns'
      cpucluster: 'cpuapp'
```
